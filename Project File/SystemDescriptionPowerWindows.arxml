AUTOSAR XML (schema 00050)
package /ARRoot
  can cluster PowerWindowFrontLeftCanCluster
    can physical channel PowerWindowFrontLeftCanPhysicalChannel: comm-connectors=PowerWindowFrontLeftCanCommunicationConnector
  ecu instance PowerWindowFrontLeftECUInstance
    can communication controller PowerWindowFrontLeftCanCommunicationController
    can communication connector PowerWindowFrontLeftCanCommunicationConnector: comm-controller=PowerWindowFrontLeftCanCommunicationController
  flat map PowerWindowFrontLeftFlatMap: instances=flat-instance-descriptor=PowerWindowFrontLeftSystem.PowerWindowFrontLeftRootSwComposition.MotorControlFrontRight
  system PowerWindowFrontLeftSystem
    system mapping PowerWindowFrontLeftSwMapping
      data-mappings:
        client-server-to-signal-mapping=communication-direction=IN
        client-server-to-signal-mapping=communication-direction=IN
        sender-receiver-to-signal-mapping=communication-direction=OUT
      sw-impl-mappings:
        swc to impl mapping PowerWindowFrontLeftSwcToImplMapping: component-implementation=PowerWindowImpFile, component=PowerWindowFrontLeftRootSwComposition.PowerWindowsFrontLeftSwComponentPrototype.PowerWindowsFrontLeftSwComponentPrototype
      sw-mappings:
        swc to ecu mapping PowerWindowFrontLeftSwcToEcuMapping: component=PowerWindowFrontLeftRootSwComposition.PowerWindowsFrontLeftSwComponentPrototype.PowerWindowsFrontLeftSwComponentPrototype, ecu-instance=PowerWindowFrontLeftECUInstance
    root-software-compositions:
      root sw composition prototype PowerWindowFrontLeftRootSwComposition: flat-map=PowerWindowFrontLeftFlatMap, software-composition=PowerWindowsFrontLeftTopLevelComposition
  can cluster PowerWindowFrontRightCanCluster
    can physical channel PowerWindowFrontRightCanPhysicalChannel: comm-connectors=PowerWindowFrontRightCanCommunicationConnector
  ecu instance PowerWindowFrontRightECUInstance
    can communication controller PowerWindowFrontRightCanCommunicationController
    can communication connector PowerWindowFrontRightCanCommunicationConnector: comm-controller=PowerWindowFrontRightCanCommunicationController
  flat map PowerWindowFrontRightFlatMap: instances=flat-instance-descriptor=PowerWindowFrontRightSystem.PowerWindowFrontRightRootSwComposition.MotorControlFrontRight
  system PowerWindowFrontRightSystem
    system mapping PowerWindowFrontRightSwMapping
      data-mappings:
        client-server-to-signal-mapping=communication-direction=IN
        client-server-to-signal-mapping=communication-direction=IN
        sender-receiver-to-signal-mapping=communication-direction=OUT
      sw-impl-mappings:
        swc to impl mapping PowerWindowFrontRightSwcToImplMapping: component-implementation=PowerWindowImpFile, component=PowerWindowFrontRightRootSwComposition.PowerWindowsFrontRightSwComponentPrototype.PowerWindowsFrontRightSwComponentPrototype
      sw-mappings:
        swc to ecu mapping PowerWindowFrontRightSwcToEcuMapping: component=PowerWindowFrontRightRootSwComposition.PowerWindowsFrontRightSwComponentPrototype.PowerWindowsFrontRightSwComponentPrototype, ecu-instance=PowerWindowFrontRightECUInstance
    root-software-compositions:
      root sw composition prototype PowerWindowFrontRightRootSwComposition: flat-map=PowerWindowFrontRightFlatMap, software-composition=PowerWindowsFrontRightTopLevelComposition
  can cluster PowerWindowRearLeftCanCluster
    can physical channel PowerWindowRearLeftCanPhysicalChannel: comm-connectors=PowerWindowRearLeftCanCommunicationConnector
  ecu instance PowerWindowRearLeftECUInstance
    can communication controller PowerWindowRearLeftCanCommunicationController
    can communication connector PowerWindowRearLeftCanCommunicationConnector: comm-controller=PowerWindowRearLeftCanCommunicationController
  flat map PowerWindowRearLeftFlatMap: instances=flat-instance-descriptor=PowerWindowRearLeftSystem.PowerWindowRearLeftRootSwComposition.MotorControlRearRight
  system PowerWindowRearLeftSystem
    system mapping PowerWindowRearLeftSwMapping
      data-mappings:
        client-server-to-signal-mapping=communication-direction=IN
        client-server-to-signal-mapping=communication-direction=IN
        sender-receiver-to-signal-mapping=communication-direction=OUT
      sw-impl-mappings:
        swc to impl mapping PowerWindowRearLeftSwcToImplMapping: component-implementation=PowerWindowImpFile, component=PowerWindowRearLeftRootSwComposition.PowerWindowsRearLeftSwComponentPrototype.PowerWindowsRearLeftSwComponentPrototype
      sw-mappings:
        swc to ecu mapping PowerWindowRearLeftSwcToEcuMapping: component=PowerWindowRearLeftRootSwComposition.PowerWindowsRearLeftSwComponentPrototype.PowerWindowsRearLeftSwComponentPrototype, ecu-instance=PowerWindowRearLeftECUInstance
    root-software-compositions:
      root sw composition prototype PowerWindowRearLeftRootSwComposition: flat-map=PowerWindowRearLeftFlatMap, software-composition=PowerWindowsRearLeftTopLevelComposition
  can cluster PowerWindowRearRightCanCluster
    can physical channel PowerWindowRearRightCanPhysicalChannel: comm-connectors=PowerWindowRearRightCanCommunicationConnector
  ecu instance PowerWindowRearRightECUInstance
    can communication controller PowerWindowRearRightCanCommunicationController
    can communication connector PowerWindowRearRightCanCommunicationConnector: comm-controller=PowerWindowRearRightCanCommunicationController
  flat map PowerWindowRearRightFlatMap: instances=flat-instance-descriptor=PowerWindowRearRightSystem.PowerWindowRearRightRootSwComposition.MotorControlRearRight
  system PowerWindowRearRightSystem
    system mapping PowerWindowRearRightSwMapping
      data-mappings:
        client-server-to-signal-mapping=communication-direction=IN
        client-server-to-signal-mapping=communication-direction=IN
        sender-receiver-to-signal-mapping=communication-direction=OUT
      sw-impl-mappings:
        swc to impl mapping PowerWindowRearRightSwcToImplMapping: component-implementation=PowerWindowImpFile, component=PowerWindowRearRightRootSwComposition.PowerWindowsRearRightSwComponentPrototype.PowerWindowsRearRightSwComponentPrototype
      sw-mappings:
        swc to ecu mapping PowerWindowRearRightSwcToEcuMapping: component=PowerWindowRearRightRootSwComposition.PowerWindowsRearRightSwComponentPrototype.PowerWindowsRearRightSwComponentPrototype, ecu-instance=PowerWindowRearRightECUInstance
    root-software-compositions:
      root sw composition prototype PowerWindowRearRightRootSwComposition: flat-map=PowerWindowRearRightFlatMap, software-composition=PowerWindowsRearRightTopLevelComposition
  composition sw component type PowerWindowsFrontLeftTopLevelComposition
    component PowerWindowsFrontLeftSwComponentPrototype: type=PowerWindowControllerType
    delegation sw connector PowerWindowFrontLeftConnectorProto: outer-port=MotorControlFrontLeft
    delegation sw connector PowerWindowFrontLeftConnectorProto: outer-port=AntiPinchFrontLeft
    delegation sw connector PowerWindowFrontLeftConnectorProto: outer-port=WindowSwitchFrontLeft
  composition sw component type PowerWindowsFrontRightTopLevelComposition
    component PowerWindowsFrontRightSwComponentPrototype: type=PowerWindowControllerType
    delegation sw connector PowerWindowFrontRightConnectorProto: outer-port=MotorControlFrontRight
    delegation sw connector PowerWindowFrontRightConnectorProto: outer-port=AntiPinchFrontRight
    delegation sw connector PowerWindowFrontRightConnectorProto: outer-port=WindowSwitchFrontRight
  composition sw component type PowerWindowsRearLeftTopLevelComposition
    component PowerWindowsRearLeftSwComponentPrototype: type=PowerWindowControllerType
    delegation sw connector PowerWindowRearLeftConnectorProto: outer-port=MotorControlRearLeft
    delegation sw connector PowerWindowRearLeftConnectorProto: outer-port=AntiPinchRearLeft
    delegation sw connector PowerWindowRearLeftConnectorProto: outer-port=WindowSwitchRearLeft
  composition sw component type PowerWindowsRearRightTopLevelComposition
    component PowerWindowsRearRightSwComponentPrototype: type=PowerWindowControllerType
    delegation sw connector PowerWindowRearRightConnectorProto: outer-port=MotorControlRearRight
    delegation sw connector PowerWindowRearRightConnectorProto: outer-port=AntiPinchRearRight
    delegation sw connector PowerWindowRearRightConnectorProto: outer-port=WindowSwitchRearRight
